## tools/yocto/meta-sentinel/conf/layer.conf
```bitbake
# Yocto layer configuration for Sentinel Gateway
# Add to bblayers.conf: BBLAYERS += "/path/to/meta-sentinel"

BBPATH .= ":${LAYERDIR}"
BBFILES += "${LAYERDIR}/recipes-*/*/*.bb ${LAYERDIR}/recipes-*/*/*.bbappend"
BBFILE_COLLECTIONS += "meta-sentinel"
BBFILE_PATTERN_meta-sentinel = "^${LAYERDIR}/"
BBFILE_PRIORITY_meta-sentinel = "6"

LAYERDEPENDS_meta-sentinel = "core"
LAYERSERIES_COMPAT_meta-sentinel = "scarthgap"
```
